## os-image/buildroot/configs/kiacha_defconfig
```kconfig
BR2_x86_64=y
BR2_x86_64_core2=y
BR2_KERNEL_LINUX_SITE="https://cdn.kernel.org/pub/linux/kernel/v6.x"
BR2_KERNEL_LINUX_VERSION="6.9"
BR2_LINUX_KERNEL_CUSTOM_CONFIG_FILE="board/kiacha/linux.config"
BR2_LINUX_KERNEL_VMLINUX=y

# Bootloader
BR2_TARGET_GRUB2=y
BR2_TARGET_GRUB2_I386_PC=y
BR2_TARGET_GRUB2_INSTALL_TOOLS=y

# Filesystem
BR2_TARGET_ROOTFS_CPIO_GZIP=y
BR2_TARGET_ROOTFS_CPIO_GZ=y
BR2_ROOTFS_DEVICE_CREATION_DYNAMIC_UDEV=y

# systemd init system
BR2_INIT_SYSTEMD=y
BR2_PACKAGE_SYSTEMD=y
BR2_PACKAGE_SYSTEMD_JOURNAL_REMOTE=y
BR2_PACKAGE_SYSTEMD_COREDUMP=y
BR2_PACKAGE_SYSTEMD_HWDB=y
BR2_PACKAGE_SYSTEMD_ENABLE_COREDUMP=y

# Essentials
BR2_PACKAGE_BUSYBOX=y
BR2_PACKAGE_BUSYBOX_CONFIG="package/busybox/busybox.config"
BR2_PACKAGE_BASH=y

# Networking
BR2_PACKAGE_DHCP=y
BR2_PACKAGE_DHCPCD=y
BR2_PACKAGE_OPENSSH=y
BR2_PACKAGE_OPENSSH_SERVER=y
BR2_PACKAGE_IPROUTE2=y
BR2_PACKAGE_WIRELESS_TOOLS=y
BR2_PACKAGE_CURL=y
BR2_PACKAGE_WGET=y

# Development tools
BR2_PACKAGE_GIT=y
BR2_PACKAGE_CMAKE=y
BR2_PACKAGE_MAKE=y

# Node.js runtime (for Fastify backend)
BR2_PACKAGE_NODEJS=y
BR2_PACKAGE_NODEJS_NPM=y
BR2_PACKAGE_NODEJS_ENABLE_INSPECTOR=y

# Audio/Multimedia (for Whisper, Piper)
BR2_PACKAGE_ALSA_LIB=y
BR2_PACKAGE_ALSA_UTILS=y
BR2_PACKAGE_FFMPEG=y
BR2_PACKAGE_FFMPEG_LIBVPX=y
BR2_PACKAGE_FFMPEG_LIBOPUS=y

# Video (for camera)
BR2_PACKAGE_V4L_UTILS=y
BR2_PACKAGE_LIBV4L=y

# Sensors/I2C (for hardware)
BR2_PACKAGE_I2C_TOOLS=y
BR2_PACKAGE_LIBI2C=y

# Python (for scripts)
BR2_PACKAGE_PYTHON3=y
BR2_PACKAGE_PYTHON3_PIP=y

# Utils
BR2_PACKAGE_JQ=y
BR2_PACKAGE_SCREEN=y
BR2_PACKAGE_HTOP=y
BR2_PACKAGE_NANO=y
BR2_PACKAGE_VIM=y

# Locale/Timezone
BR2_GENERATE_LOCALE="en_US.UTF-8"
BR2_TARGET_TZ_INFO=y
BR2_TZ_2016j=y

# Post-build hooks
BR2_ROOTFS_POST_BUILD_SCRIPT="board/kiacha/post-build.sh"
BR2_ROOTFS_POST_IMAGE_SCRIPT="board/kiacha/post-image.sh"
BR2_ROOTFS_OVERLAY="overlay"

# Security
BR2_PACKAGE_CA_CERTIFICATES=y
BR2_PACKAGE_OPENSSL=y

# Compression
BR2_PACKAGE_XZ=y
BR2_PACKAGE_GZIP=y
BR2_PACKAGE_BZIP2=y

# Generic system settings
BR2_TARGET_GENERIC_HOSTNAME="kiacha"
BR2_TARGET_GENERIC_ISSUE="Kiacha OS - AI Operating System"
BR2_TARGET_GENERIC_PASSWD_SHA256=y
BR2_TARGET_GENERIC_ROOT_PASSWD_SHA256="$6$kiacha$Ou5qxvfqQrPZ1VQVqLqQz/VZhI7lLAqV0hQOqBP7mCQP4PB4CQ0WQQr.CQ0WQQr.CQ0WQQr.CQ"

# Toolchain
BR2_TOOLCHAIN_BUILDROOT_GLIBC=y
BR2_PACKAGE_LINUX_HEADERS=y
BR2_PACKAGE_LINUX_HEADERS_CUSTOM_6_9=y

# Kernel
BR2_LINUX_KERNEL=y
BR2_LINUX_KERNEL_CUSTOM_VERSION=y
BR2_LINUX_KERNEL_CUSTOM_VERSION_VALUE="6.9"
BR2_LINUX_KERNEL_DEFCONFIG="x86_64"
BR2_LINUX_KERNEL_VMLINUX=y

# Root filesystem
BR2_TARGET_ROOTFS_EXT2=y
BR2_TARGET_ROOTFS_EXT2_4=y
BR2_TARGET_ROOTFS_EXT2_SIZE="2G"
BR2_ROOTFS_DEVICE_CREATION_DYNAMIC_UDEV=y
```
